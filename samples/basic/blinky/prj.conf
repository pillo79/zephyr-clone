## CMakeLists.txt
```
# SPDX-License-Identifier: Apache-2.0

cmake_minimum_required(VERSION 3.20.0)
find_package(Zephyr REQUIRED HINTS $ENV{ZEPHYR_BASE})

project(blinky)
target_sources(app PRIVATE src/main.c src/sysled.c)
target_include_directories(app PRIVATE src/)
```

## sample.yaml
```
sample:
  name: Blinky Sample
tests:
  sample.basic.blinky:
    tags:
      - LED
      - gpio
    filter: dt_enabled_alias_with_parent_compat("led0", "gpio-leds")
    depends_on: gpio
    harness: 
      - console
      - led
    integration_platforms:
      - frdm_k64f
```

## prj.conf
```kconfig
CONFIG_GPIO=y
CONFIG_USERSPACE=y
CONFIG_APPLICATION_DEFINED_SYSCALL=y
```

## app.overlay
```dts
&uart4 {
	status = "okay";
	manual-init;
};
```

## src/main.c
```c
/*
 * Copyright (c) 2016 Intel Corporation
 *
 * SPDX-License-Identifier: Apache-2.0
 */

#include <zephyr/kernel.h>
#include <zephyr/drivers/gpio.h>

#include "sysled.h"

/* 1000 msec = 1 sec */
#define SLEEP_TIME_MS   1000

/* The devicetree node identifier for the "led0" alias. */
#define LED0_NODE DT_ALIAS(led0)

/* change this to any other UART peripheral if desired */
#define UART_DEVICE_NODE DT_NODELABEL(uart4)

static const struct device *const uart_dev = DEVICE_DT_GET(UART_DEVICE_NODE);
#include <zephyr/drivers/uart.h>

/*
 * A build error on this line means your board is unsupported.
 * See the sample documentation for information on how to fix this.
 */
//static const struct gpio_dt_spec led = GPIO_DT_SPEC_GET(LED0_NODE, gpios);

int main(void)
{
	int ret;

	initLeds();
/*
	if (!gpio_is_ready_dt(&led)) {
		return 0;
	}

	ret = gpio_pin_configure_dt(&led, GPIO_OUTPUT_ACTIVE);
	if (ret < 0) {
		return 0;
	}
*/
	ret = device_init(uart_dev);
	if (ret < 0) {
		printk("UART device init err %i", ret);
		return 0;
	}

	if (!device_is_ready(uart_dev)) {
		printk("UART device not found!");
		return 0;
	}

	const char *msg="0123456789abcdef";
	int i=0;
	ret = SetLed(0, 1);
	while (1) {
		static int st = 1;
		st = !st;
		if (ret < 0) {
			return 0;
		}
		k_msleep(SLEEP_TIME_MS);
		ret = SetLed(0, st);
		uart_poll_out(uart_dev, msg[(i++) & 0xf]);
	}
	return 0;
}
```

## src/sysled.c
```c
/**
 ******************************************************************************
 * @file    led.c
 * @brief   Contains APIs for setting state of the LED
 ******************************************************************************
 * @attention
 *
 * LICENSE
 *
 * The MIT License (MIT)
 *
 * Copyright (c) 2020 Rohit Gujarathi rgujju.github.io
 *
 * Permission is hereby granted, free of charge, to any person obtaining a copy
 * of this software and associated documentation files (the "Software"), to deal
 * in the Software without restriction, including without limitation the rights
 * to use, copy, modify, merge, publish, distribute, sublicense, and/or sell
 * copies of the Software, and to permit persons to whom the Software is
 * furnished to do so, subject to the following conditions:
 *
 * The above copyright notice and this permission notice shall be included in all
 * copies or substantial portions of the Software.
 *
 * THE SOFTWARE IS PROVIDED "AS IS", WITHOUT WARRANTY OF ANY KIND, EXPRESS OR
 * IMPLIED, INCLUDING BUT NOT LIMITED TO THE WARRANTIES OF MERCHANTABILITY,
 * FITNESS FOR A PARTICULAR PURPOSE AND NONINFRINGEMENT. IN NO EVENT SHALL THE
 * AUTHORS OR COPYRIGHT HOLDERS BE LIABLE FOR ANY CLAIM, DAMAGES OR OTHER
 * LIABILITY, WHETHER IN AN ACTION OF CONTRACT, TORT OR OTHERWISE, ARISING FROM,
 * OUT OF OR IN CONNECTION WITH THE SOFTWARE OR THE USE OR OTHER DEALINGS IN THE
 * SOFTWARE.
*/


#include <stdint.h>
#include "sysled.h"

#include <zephyr/device.h>
#include <zephyr/devicetree.h>
#include <zephyr/drivers/gpio.h>
#include <zephyr/logging/log.h>
// TODO: Change Log module debug level from build system
LOG_MODULE_REGISTER(led, 4);

#define LED0_NODE DT_ALIAS(led0)
#if DT_NODE_HAS_STATUS(LED0_NODE, okay)
    #define LED0_DEV	DT_GPIO_LABEL(LED0_NODE, gpios)
    #define LED0_PIN	DT_GPIO_PIN(LED0_NODE, gpios)
    #if DT_PHA_HAS_CELL(LED0_NODE, gpios, flags)
        #define LED0_FLAGS	DT_GPIO_FLAGS(LED0_NODE, gpios)
    #endif

    #ifndef LED0_FLAGS
        #define LED0_FLAGS	0
    #endif

#else
    #error "Unsupported board: led0 is not aliased in device tree."
#endif

#define LED1_NODE DT_ALIAS(led1)
#if DT_NODE_HAS_STATUS(LED1_NODE, okay)
    #define LED1_DEV	DT_GPIO_LABEL(LED1_NODE, gpios)
    #define LED1_PIN	DT_GPIO_PIN(LED1_NODE, gpios)
    #if DT_PHA_HAS_CELL(LED1_NODE, gpios, flags)
        #define LED1_FLAGS	DT_GPIO_FLAGS(LED1_NODE, gpios)
    #endif

    #ifndef LED1_FLAGS
        #define LED1_FLAGS	0
    #endif
#else
    #error "Unsupported board: led1 is not aliased in device tree."
#endif


static const struct gpio_dt_spec led0 = GPIO_DT_SPEC_GET(LED0_NODE, gpios);
static const struct gpio_dt_spec led1 = GPIO_DT_SPEC_GET(LED1_NODE, gpios);

int8_t initLeds(void) {
    // Initialize GPIO and LED
    int ret;
    ret = gpio_pin_configure_dt(&led0, GPIO_OUTPUT_ACTIVE | LED0_FLAGS);
    if (ret < 0) {
        return -1;
    }
    ret = gpio_pin_configure_dt(&led1, GPIO_OUTPUT_INACTIVE | LED1_FLAGS);
    if (ret < 0) {
        return -1;
    }
    return 0;
}

int8_t z_impl_SetLed(uint8_t Led_Num, uint8_t Led_State) {
    switch(Led_Num) {
        case 0:
            gpio_pin_set_dt(&led0, (int)Led_State);
            break;
        case 1:
            gpio_pin_set_dt(&led1, (int)Led_State);
            break;
        default:
            return -1;
    }
    LOG_DBG("Setting LED%d to o%s",Led_Num, Led_State ? "n" : "ff");
    return 0;
}

static int8_t z_vrfy_SetLed(uint8_t Led_Num, uint8_t Led_State){
    
    return z_impl_SetLed(Led_Num, Led_State);
    
}
#include <zephyr/kernel/thread.h>
```

## src/sysled.h
```c
/**
 ******************************************************************************
 * @file    led.h
 * @brief   Contains APIs for setting state of LED
 ******************************************************************************
 * @attention
 *
 * LICENSE
 *
 * The MIT License (MIT)
 *
 * Copyright (c) 2020 Rohit Gujarathi rgujju.github.io
 *
 * Permission is hereby granted, free of charge, to any person obtaining a copy
 * of this software and associated documentation files (the "Software"), to deal
 * in the Software without restriction, including without limitation the rights
 * to use, copy, modify, merge, publish, distribute, sublicense, and/or sell
 * copies of the Software, and to permit persons to whom the Software is
 * furnished to do so, subject to the following conditions:
 *
 * The above copyright notice and this permission notice shall be included in all
 * copies or substantial portions of the Software.
 *
 * THE SOFTWARE IS PROVIDED "AS IS", WITHOUT WARRANTY OF ANY KIND, EXPRESS OR
 * IMPLIED, INCLUDING BUT NOT LIMITED TO THE WARRANTIES OF MERCHANTABILITY,
 * FITNESS FOR A PARTICULAR PURPOSE AND NONINFRINGEMENT. IN NO EVENT SHALL THE
 * AUTHORS OR COPYRIGHT HOLDERS BE LIABLE FOR ANY CLAIM, DAMAGES OR OTHER
 * LIABILITY, WHETHER IN AN ACTION OF CONTRACT, TORT OR OTHERWISE, ARISING FROM,
 * OUT OF OR IN CONNECTION WITH THE SOFTWARE OR THE USE OR OTHER DEALINGS IN THE
 * SOFTWARE.
*/

#ifndef _RATCH_LED_H_
#define _RATCH_LED_H_

#include <zephyr/toolchain.h>

/** LED 0 */
#define LED0 0
/** LED 1 */
#define LED1 1
/** LED_ON state */
#define LED_ON 1
/** LED_OFF state */
#define LED_OFF 0

/** @brief  Change state of LED to on/off
 * 
 *  @note   This API is compiled only in the KERNEL, not in the userlib
 *          To call this API, from the app. use 'SetLed(LED1, LED_ON);'
 *          it will generate a svc and jump to implementation function
 *          in the kernel
 *
 *  @param  Led_Num Which LED to turn on
 *
 *  @param  Led_State Set the state of LED to on (1) or off (0)
 *
 *  @retval 0 
 *
*/
__syscall int8_t SetLed(uint8_t Led_Num, uint8_t Led_State);

#include <syscalls/sysled.h>
#endif /* _RATCH_LED_H_ */
```
